## boards/arm/nucleo_l433rc/Kconfig.board
```kconfig
# STM32L433RC Nucleo board configuration
#
# Copyright (c) 2019 Libre Solar Technologies GmbH
#
# SPDX-License-Identifier: Apache-2.0

config BOARD_NUCLEO_L433RC
	bool "Nucleo L433RC Development Board"
	depends on SOC_STM32L433XX
```

## boards/arm/nucleo_l433rc_p/Kconfig.defconfig
```kconfig
# STM32 NUCLEO-L433RC-P board configuration
#
# Copyright (c) 2019 IP-Logix Inc.
#
# SPDX-License-Identifier: Apache-2.0

if BOARD_NUCLEO_L433RC_P

config BOARD
	default "nucleo_l433rc_p"

config SPI_STM32_INTERRUPT
	default y

endif # BOARD_NUCLEO_L433RC_P
```
